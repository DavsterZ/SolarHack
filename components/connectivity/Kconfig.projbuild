## components/connectivity/Kconfig.projbuild
```kconfig
menu "WiFi (Modo AP)"
    config WIFI_AP_SSID
        string "SSID del AP de Configuración"
        default "ESP32_CONFIG"
        help
            Nombre de la red WiFi que generará el ESP32 si no tiene credenciales.

    config WIFI_AP_PASS
        string "Contraseña del AP (Dejar vacío para abierto)"
        default ""
        help
            Contraseña WPA2 para el AP. Si se deja vacío, la red será abierta.

    config WIFI_AP_MAX_CONN
        int "Máximo de clientes AP"
        default 4
        range 1 10
endmenu

menu "Configuración MQTT"
    config BROKER_URL_MQTT
        string "URL del Broker MQTT"
        default "mqtt://demo.thingsboard.io"
        help
            URL completa del broker (ej: mqtt://192.168.1.100 o mqtt://broker.hivemq.com)

    config MQTT_TOKEN
        string "Token de Acceso / Username"
        default "TU_ACCESS_TOKEN"
        help
            Usuario o Token para autenticación (común en ThingsBoard).
            
    config MQTT_TOPIC_TELEMETRY
        string "Tópico de Telemetría"
        default "v1/devices/me/telemetry"
        help
            Tópico donde se publicará el JSON.
endmenu

menu "Telegram Bot"
    config TELEGRAM_TOKEN
        string "Token del Bot"
        default "TU_TOKEN_AQUI"
        help
            El token que te da @BotFather (ej: 123456:ABC-DEF1234ghIkl-zyx57W2v1u123ew11).

    config TELEGRAM_CHAT_ID
        string "ID de Chat Autorizado"
        default "TU_CHAT_ID"
        help
            Tu ID numérico de usuario (puedes obtenerlo con @userinfobot).
            Esto es CRITICO para que nadie más controle tu panel.
            
    config POLLING_INTERVAL_MS
        int "Periodo Lectura Telegram Bot (ms)"
        default 5000
        help
            Cada cuánto tiempo se revisan los mensajes del telegram bot.
endmenu
```

## components/logic/Kconfig.projbuild
```kconfig
menu "Solar Tracker (Servos)"
    config TRACKER_TOLERANCE
        int "Tolerancia (Banda Muerta)"
        default 100
        help
            Diferencia mínima de lectura ADC para mover el servo. Evita vibraciones.

    config TRACKER_STEP_DEG
        string "Pasos por ciclo (Grados)"
        default "2.0"
        help
            Cuantos grados se mueve el servo en cada ciclo de actualización.
            
    config TRACKER_UPDATE_MS
        int "Periodo de actualización (ms)"
        default 100
        help
            Cada cuánto tiempo se recalcula la posición.
endmenu
```

## components/sensors/Kconfig.projbuild
```kconfig
menu "Sensores de Luz (ADC/LDR)"
    config LDR_MIN_OHM
        int "Resistencia Mínima LDR (Ohms)"
        default 4000
        help
            Valor de resistencia en máxima luminosidad (luz directa).

    config LDR_MAX_OHM
        int "Resistencia Máxima LDR (Ohms)"
        default 1000000
        help
            Valor de resistencia en oscuridad total.
endmenu

menu "Hardware I2C"
    config I2C_SDA_PIN
        int "Pin SDA"
        default 21
        
    config I2C_SCL_PIN
        int "Pin SCL"
        default 22
        
    config I2C_FREQ_HZ
        int "Frecuencia I2C (Hz)"
        default 100000
endmenu

menu "Batería y Energía"
    config BAT_CAPACITY_AH
        string "Capacidad de la Batería (Ah)"
        default "2.6"
        help
            Capacidad nominal de la batería en Amperios-hora.

    config SHUNT_RESISTOR_OHM
        string "Resistencia Shunt INA219 (Ohms)"
        default "0.1"
        help
            Valor de la resistencia shunt (Rshunt).

    config MAX_CURRENT_PANEL_A
        string "Corriente Máxima INA219 (P)"
        default "1.0"
        
    config MAX_CURRENT_BAT_A
        string "Corriente Máxima INA219 (B)"
        default "1.0"
        
    config INA_ADDR_PANEL
        hex "Dirección I2C Sensor Panel"
        default 0x40
        range 0x40 0x4F
        help
            Dirección I2C física del sensor INA219 conectado al Panel.

    config INA_ADDR_BAT
        hex "Dirección I2C Sensor Batería"
        default 0x41
        range 0x40 0x4F
        help
            Dirección I2C física del sensor INA219 conectado a la Batería.
endmenu
```

## components/servo_control/Kconfig.projbuild
```kconfig
menu "Control servos"
	config SERVO_PIN_HORIZ
            int "Pin Servo Horizontal (Base)"
            default 18
            help
                GPIO conectado a la señal PWM del servo de giro.

    config SERVO_PIN_VERT
        int "Pin Servo Vertical (Elevación)"
        default 19
        help
            GPIO conectado a la señal PWM del servo de altura.
endmenu
```

## main/Kconfig.projbuild
```kconfig
menu "Configuración del Sistema"
    menu "Tiempos y Tareas (Periodos)"
        config TASK_INA_PERIOD_MS
            int "Periodo Tarea INA (ms)"
            default 1000
            help
                Cada cuánto tiempo se leen los sensores de corriente.

        config TASK_ADC_PERIOD_MS
            int "Periodo Tarea ADC (ms)"
            default 3000
            help
                Cada cuánto tiempo se leen los LDRs.

        config MAIN_LOOP_PERIOD_S
            int "Periodo Main Loop (s)"
            default 5
            help
                Periodo para mostrar logs generales y guardar datos en Main.
    endmenu
    
    menu "Ahorro de Energía (Deep Sleep)"
        config SLEEP_START_HOUR
            int "Hora de inicio de sueño (0-23)"
            default 20
            help
                Hora a la que el sistema aparca los servos y entra en Deep Sleep (aprox. anochecer).

        config SLEEP_WAKE_HOUR
            int "Hora de despertar (0-23)"
            default 7
            help
                Hora a la que el sistema se despierta para buscar el sol (aprox. amanecer).

        config TIME_ZONE
            string "Zona Horaria (Formato POSIX)"
            default "CET-1CEST,M3.5.0,M10.5.0/3"
            help
                Cadena POSIX para la zona horaria (Ejemplo por defecto: España/Europa Central).
    endmenu
endmenu
```
